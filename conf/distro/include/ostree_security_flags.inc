## conf/distro/ostree.conf
```bitbake
ENABLE_BINARY_LOCALE_GENERATION = "0"
GLIBC_GENERATE_LOCALES = " "

INSANE_SKIP_${PN} = "installed-vs-shipped " 


DISTRO_FEATURES += "systemd"
IMAGE_INSTALL_append = " ostree"

APPEND_append = " bootparam_rootdelay=5 "
APPEND_append = " bootparam_roottimeout=5 "
```

## conf/layer.conf
```bitbake
# We have a conf and classes directory, add to BBPATH
BBPATH := "${BBPATH}:${LAYERDIR}"

# We have a packages directory, add to BBFILES
BBFILES += "${LAYERDIR}/recipes-*/*/*.bb \
            ${LAYERDIR}/recipes-*/*/*.bbappend"

BBMASK = ".*/meta-oe/recipes-extended/efivar"
BBMASK .= "|.*/meta-oe/recipes-extended/efibootmgr"

BBFILE_COLLECTIONS += "meta-ostree"
BBFILE_PATTERN_meta-ostree = "^${LAYERDIR}/"
BBFILE_PRIORITY_meta-ostree = "6"

LAYERVERSION_meta-ostree = "1"

SIGGEN_EXCLUDE_SAFE_RECIPE_DEPS += "\
  oe-ostree-helpers->bash \
"

# Set a variable for easy access to the top directory of the ostree layer.
OSTREEBASE = "${@os.path.normpath('${LAYERDIR}/../meta-ostree')}"

SUPPORTED_RECIPES_append = " \
    ${OSTREEBASE}/conf/ostree-supported-recipes.txt \
    ${OSTREEBASE}/conf/ostree-dependent-recipes.txt\ 
"

require conf/distro/include/ostree_security_flags.inc
```
